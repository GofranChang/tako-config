/* Sweep-Pro processors on the actual central, including dongle. */
#include "tako-cirque-split.dtsi"
#include "tako-sweep-pro-processors.dtsi"
&tako_cirque_listener {
    status = "okay";
    input-processors = <&pointer_processor 0 0 &drag_scroll_processor 1 8>;
};
