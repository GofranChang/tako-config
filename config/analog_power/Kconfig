## config/boards/shields/tako/Kconfig.defconfig
```kconfig
if SHIELD_TAKO_DONGLE || SHIELD_TAKO_LEFT

config ZMK_KEYBOARD_NAME
  default "Tako"

endif

if SHIELD_TAKO_DONGLE

config ZMK_SPLIT_ROLE_CENTRAL
  default y

endif

if SHIELD_TAKO_LEFT || SHIELD_TAKO_RIGHT || SHIELD_TAKO_DONGLE

config ZMK_SPLIT
  default y

endif

if SHIELD_TAKO_LEFT || SHIELD_TAKO_RIGHT

config I2C
  default n

endif
```

## config/boards/shields/tako/Kconfig.shield
```kconfig
config SHIELD_TAKO_LEFT
  def_bool $(shields_list_contains,tako_left)

config SHIELD_TAKO_RIGHT
  def_bool $(shields_list_contains,tako_right)

config SHIELD_TAKO_DONGLE
  def_bool $(shields_list_contains,tako_dongle)

config SHIELD_TAKO_CIRQUE_RIGHT
  def_bool $(shields_list_contains,tako_cirque_right)

config SHIELD_TAKO_CIRQUE_RECEIVER
  def_bool $(shields_list_contains,tako_cirque_receiver)

config SHIELD_TAKO_DONGLE_DIAGNOSTICS
  def_bool $(shields_list_contains,tako_dongle_diagnostics)

config SHIELD_TAKO_CIRQUE_PROBE
  def_bool $(shields_list_contains,tako_cirque_probe)

config SHIELD_TAKO_CIRQUE_TX8
  def_bool $(shields_list_contains,tako_cirque_tx8)
```

## config/west.yml
```yaml
manifest:
  remotes:
    - name: zmkfirmware
      url-base: https://github.com/zmkfirmware
    - name: gofran
      url-base: https://github.com/GofranChang
    - name: englmaxi
      url-base: https://github.com/englmaxi
    - name: nxtkb
      url-base: https://github.com/nxtkb
    - name: gpeye
      url-base: https://github.com/GPeye
  projects:
    - name: zmk
      remote: zmkfirmware
      revision: v0.3
      import: app/west.yml
    - name: analog-matrix-module
      remote: gofran
      revision: 3cb997880834b7147f96107d7564840f0013af1c
    - name: zmk-dongle-display
      remote: englmaxi
      revision: c6c4be11c5ede722086a2a1f355cec9c101b9390 # v0.3-compatible display
    - name: hammerbeam-slideshow
      remote: gpeye
      revision: 9c16436efa4c87d19e2e4558927969c7ddd5851d
    # Same Cirque driver revision as nxtkb/Sweep-Pro at 9bf146c.
    - name: cirque-input-module
      remote: nxtkb
      revision: 8af03a4c061580c14ec8745caf0fa2dd3fc7f042
  self:
    path: config
```
